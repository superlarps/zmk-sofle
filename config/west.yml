## config/west.yml
```yaml
manifest:
  remotes:
    - name: zmkfirmware
      url-base: https://github.com/zmkfirmware
    - name: urchin-peripheral-animation                         #new entry
      url-base: https://github.com/superlarps
  projects:
    - name: urchin-peripheral-animation   #new entry
      remote: urchin-peripheral-animation
      revision: main                      #new entry
    - name: eyelash_sofle
      url: https://github.com/a741725193/zmk-sofle
      revision: main
    - name: zmk
      remote: zmkfirmware
      revision: v0.3.0
      import: app/west.yml
  self:
    path: boards
    
```
